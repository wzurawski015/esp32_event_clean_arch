## firmware/components/app__demo_lcd/Kconfig
```kconfig
menu "App Demo: LCD RGB"

    menu "I2C Configuration"
        config APP_I2C_SDA
            int "I2C SDA (GPIO)"
            range 0 48
            default 10 if IDF_TARGET_ESP32C6
            default 8  if IDF_TARGET_ESP32C3
            default 21 if IDF_TARGET_ESP32 || IDF_TARGET_ESP32S3
            default 33 if IDF_TARGET_ESP32S2

        config APP_I2C_SCL
            int "I2C SCL (GPIO)"
            range 0 48
            default 11 if IDF_TARGET_ESP32C6
            default 9  if IDF_TARGET_ESP32C3
            default 22 if IDF_TARGET_ESP32 || IDF_TARGET_ESP32S3
            default 35 if IDF_TARGET_ESP32S2

        config APP_I2C_HZ
            int "I2C Frequency (Hz)"
            range 10000 1000000
            default 100000

        config APP_I2C_PULLUP
            bool "Enable internal I2C pull-ups"
            default y
    endmenu

    menu "LCD Hardware (DFR0464)"
        config APP_LCD_ADDR
            hex "LCD Address (7-bit)"
            default 0x3E

        config APP_RGB_ADDR
            hex "RGB Address (7-bit)"
            default 0x2D

        config APP_LCD_CONTR_HIGH
            int "Contrast High (0..3)"
            default 2

        config APP_LCD_CONTR_LOW
            int "Contrast Low (0..15)"
            default 8

        config APP_LCD_INIT_FIRST_DELAY_MS
            int "Init Delay (ms)"
            default 40

        config APP_LCD_BURST_SIZE
            int "Burst Size"
            default 16

        config APP_LCD_INTERCHUNK_DELAY_MS
            int "Inter-chunk Delay (ms)"
            default 1
            
        config APP_LCD_CMD_CTRL_0X80
            bool "Use 0x80 control byte"
            default y
    endmenu

    menu "Demo Settings"
        config APP_LCD_TEXT0
            string "Row 0 Text"
            default "ESP32 Event LCD"

        config APP_LCD_TEXT1
            string "Row 1 Text"
            default "RGB: 16x2 DFR0464"

        config APP_RGB_R
            int "Backlight Red (0..255)"
            range 0 255
            default 16

        config APP_RGB_G
            int "Backlight Green (0..255)"
            range 0 255
            default 32

        config APP_RGB_B
            int "Backlight Blue (0..255)"
            range 0 255
            default 64
    endmenu
endmenu
```

## firmware/components/core__ev/Kconfig
```kconfig
menu "Core EV (event bus)"

config CORE_EV_MAX_SUBS
    int "Max number of event subscribers"
    range 1 64
    default 12
    help
      Maksymalna liczba subskrybentów event-busa.

config CORE_EV_SCHEMA_GUARD
    bool "Schema guard in ev_post*() (fail-fast on contract violation)"
    default y
    help
      Gdy włączone, ev_post()/ev_post_lease()/ev_post_from_isr() walidują
      publikowane zdarzenia względem schemy (kind, itp).
      Naruszenie kontraktu kończy się fail-fast (abort()).
      Wyłącz w buildach produkcyjnych, jeśli chcesz zero narzutu / bez abortów.

config CORE_EV_SCHEMA_SELFTEST_ON_BOOT
    bool "Run schema self-test once at ev_init()"
    default y if CORE_EV_SCHEMA_GUARD
    default n
    help
      PR2.9: Przy pierwszym wywołaniu ev_init() wykonywany jest self-test schemy:
        - duplikaty (src, code)
        - duplikaty name
        - puste name
        - niepoprawny kind
        - brak doc dla zdarzeń krytycznych (heurystyka jak w 'evstat check')
      Wykrycie problemu kończy się fail-fast (abort()).
      Opcja developerska/warsztatowa — w produkcji zwykle wyłącz.

endmenu
```

## firmware/components/core__leasepool/Kconfig
```kconfig
menu "core__leasepool"

config CORE_LEASEPOOL_SLOTS
    int "Number of fixed lease slots"
    range 4 256
    default 32

config CORE_LEASEPOOL_SLOT_BYTES
    int "Bytes per lease slot"
    range 16 1024
    default 64

config CORE_LEASEPOOL_GUARD
    bool "Enable LeasePool guard (canary + poison + fail-fast asserts)"
    default y
    help
        Adds canaries/poisoning and strict runtime validation to catch memory
        corruption early (double free, use-after-free, buffer overflow).

config CORE_LEASEPOOL_SELFTEST_ON_BOOT
    bool "Run LeasePool selftest on boot"
    default y
    depends on CORE_LEASEPOOL_GUARD
    help
        Runs a lightweight consistency check during lp_init() and prints the
        result using ROM printf. Useful for catching early corruption.

endmenu
```

## firmware/components/infrastructure__logging/Kconfig
```kconfig
menu "Infrastructure logging"

choice INFRA_LOG_LEVEL
    prompt "Globalny poziom logowania"
    default INFRA_LOG_LEVEL_VERBOSE

config INFRA_LOG_LEVEL_ERROR
    bool "ERROR"

config INFRA_LOG_LEVEL_WARN
    bool "WARN"

config INFRA_LOG_LEVEL_INFO
    bool "INFO"

config INFRA_LOG_LEVEL_DEBUG
    bool "DEBUG"

config INFRA_LOG_LEVEL_VERBOSE
    bool "VERBOSE"
endchoice

config INFRA_LOG_RINGBUF
    bool "Włącz ring-buffer loggera (ostatnie N wpisów w RAM)"
    default n
    help
      Gdy włączone, logi są dodatkowo buforowane w RAM (circular).
      Pozwala na snapshot/tail/clear przez API lub komendę CLI.

config INFRA_LOG_RINGBUF_KB
    int "Rozmiar ring-buffer (KB)"
    depends on INFRA_LOG_RINGBUF
    range 4 64
    default 8
    help
      Pojemność bufora w kilobajtach (zalecane: 8..32 KB).

# =================== CLI (opcjonalnie, zależne od ring-bufora) ===================

config INFRA_LOG_CLI
    bool "Komenda konsolowa 'logrb' (ESP-IDF console)"
    depends on INFRA_LOG_RINGBUF
    default n
    help
      Rejestruje komendę 'logrb' (stat/clear/dump/tail), dostępną
      w esp_console REPL (np. przez idf_monitor lub UART).

config INFRA_LOG_CLI_START_REPL
    bool "Uruchom REPL UART na starcie (użyj UART0)"
    depends on INFRA_LOG_CLI
    default n
    help
      Gdy włączone, startuje esp_console REPL na UART0.
      Wtedy w monitorze (idf.py monitor) można wpisywać komendy 'logrb ...'.

config INFRA_LOG_CLI_TAIL_DEFAULT
    int "Domyślny rozmiar tail (bajty)"
    depends on INFRA_LOG_CLI
    range 128 65536
    default 1024
    help
      Domyślna liczba bajtów dla 'logrb tail' (gdy nie podano N).

endmenu
```

## firmware/components/services__timer/Kconfig
```kconfig
menu "Services: deadline timer"

config SERVICES_TIMER_MAX_SLOTS
    int "Max. liczba aktywnych deadline'ów"
    range 4 64
    default 16
    help
        Maksymalna liczba równocześnie uzbrojonych timerów (deadline'ów)
        utrzymywanych przez komponent services__timer.

config SERVICES_TIMER_ENABLE_LEGACY_TICKS
    bool "(Legacy) Generuj EV_TICK_100MS / EV_TICK_1S automatycznie"
    default n
    help
        Jeśli włączone, services__timer po starcie uzbraja dwa periodyczne timery
        i publikuje EV_TICK_100MS oraz EV_TICK_1S (zachowanie jak w starszych wersjach).
        Domyślnie wyłączone — preferowane jest explicit armowanie deadline'ów.

endmenu
```

## firmware/projects/demo_ds18b20_ev/main/Kconfig.projbuild
```kconfig
menu "App configuration"

config APP_DS_GPIO
    int "GPIO DS18B20 (DQ)"
    range 0 48
    default 18
config APP_DS_RES
    int "Rozdzielczość (9..12 bit)"
    range 9 12
    default 12
config APP_DS_PERIOD_MS
    int "Okres pomiarów [ms]"
    default 2000
config APP_DS_INT_PULLUP
    bool "Wewnętrzny pull-up (zalecany i tak zewnętrzny 4.7k)"
    default y

endmenu
```

## firmware/projects/demo_hello_ev/main/sdkconfig.defaults
```kconfig
# Target ustawiany dynamicznie przez skrypt (idf.py set-target)
CONFIG_ESP_CONSOLE_UART_DEFAULT=y
CONFIG_ESP_CONSOLE_UART=y
CONFIG_ESP_CONSOLE_UART_NUM=0
CONFIG_ESP_CONSOLE_UART_BAUDRATE=115200
```

## firmware/projects/demo_lcd_rgb/sdkconfig.defaults
```kconfig
# --- CLI & REPL ---
CONFIG_INFRA_LOG_CLI=y
CONFIG_INFRA_LOG_CLI_START_REPL=y
CONFIG_INFRA_LOG_RINGBUF=y
CONFIG_INFRA_LOG_CLI_TAIL_DEFAULT=1024

# --- Poziomy logów (kompilacja vs runtime) ---
# Kompiluj do DEBUG (żeby LOGD istniały), ale domyślnie pokazuj INFO.
# CONFIG_LOG_MAXIMUM_EQUALS_DEFAULT is not set
CONFIG_LOG_MAXIMUM_LEVEL_DEBUG=y
CONFIG_LOG_DEFAULT_LEVEL_INFO=y

# --- FreeRTOS Trace / Stats (wymagane dla komendy 'tasks') ---
CONFIG_FREERTOS_USE_TRACE_FACILITY=y
CONFIG_FREERTOS_GENERATE_RUN_TIME_STATS=y
CONFIG_FREERTOS_USE_STATS_FORMATTING_FUNCTIONS=y
CONFIG_FREERTOS_VTASKLIST_INCLUDE_COREID=y
```
